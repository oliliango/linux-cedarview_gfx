## drivers/staging/android/Kconfig
```kconfig
menu "Android"

config ANDROID
	bool "Android Drivers"
	default N
	---help---
	  Enable support for various drivers needed on the Android platform

if ANDROID

config ANDROID_BINDER_IPC
	bool "Android Binder IPC Driver"
	default n

config ASHMEM
	bool "Enable the Anonymous Shared Memory Subsystem"
	default n
	depends on SHMEM || TINY_SHMEM
	help
	  The ashmem subsystem is a new shared memory allocator, similar to
	  POSIX SHM but with different behavior and sporting a simpler
	  file-based API.

config ANDROID_LOGGER
	tristate "Android log driver"
	default n

config ANDROID_LOGGER_PANIC_DUMP
	bool "Panic dump to pstore"
	default n
	depends on ANDROID_LOGGER
	depends on PSTORE
	help
	  This options allows the panic dumping of log data to persistent
	  storage. If the 'enabled' parameter is non-zero, during a panic
	  each log will be copied in binary format to pstore and, after
	  the next boot, will appear as files in the pstore file system.

config ANDROID_LOGGER_DUMPER
	tristate "Android log kernel dumper"
	help
	 uses the Android logger dumping interface to dump the logger buffers
	 to kernel console using printk's.

config ANDROID_TIMED_OUTPUT
	bool "Timed output class driver"
	default y

config ANDROID_TIMED_GPIO
	tristate "Android timed gpio driver"
	depends on GENERIC_GPIO && ANDROID_TIMED_OUTPUT
	default n

config ANDROID_LOW_MEMORY_KILLER
	bool "Android Low Memory Killer"
	default N
	---help---
	  Register processes to be killed when memory is low

config ANDROID_LOW_MEMORY_KILLER_AUTODETECT_OOM_ADJ_VALUES
	bool "Android Low Memory Killer: detect oom_adj values"
	depends on ANDROID_LOW_MEMORY_KILLER
	default y
	---help---
	  Detect oom_adj values written to
	  /sys/module/lowmemorykiller/parameters/adj and convert them
	  to oom_score_adj values.

config ANDROID_INTF_ALARM_DEV
	bool "Android alarm driver"
	depends on RTC_CLASS
	default n
	help
	  Provides non-wakeup and rtc backed wakeup alarms based on rtc or
	  elapsed realtime, and a non-wakeup alarm on the monotonic clock.
	  Also exports the alarm interface to user-space.

endif # if ANDROID

endmenu
```
